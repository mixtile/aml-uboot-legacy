## board/mixtile/Kconfig
```kconfig
config MIXTILE_EDGE
	bool "Support Mixtile EDGE board"
	default n


if MIXTILE_EDGE
source "board/mixtile/edge/Kconfig"
endif
```

## board/mixtile/edge/Kconfig
```kconfig
if TARGET_MESON_G12B

config SYS_CPU
	string
	default "armv8"

config SYS_BOARD
	string
	default "edge"

config SYS_VENDOR
	string
	default "mixtile"

config SYS_SOC
	string
	default "g12b"

config SYS_CONFIG_NAME
	default "edge"

endif
```
